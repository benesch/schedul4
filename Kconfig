## Kconfig
```kconfig
mainmenu "schedul4 configuration"

config COMMON_PATH
    string
    option env="COMMON_PATH"

menu "Kernel"
    source "kernel/Kconfig"
endmenu

menu "Libraries"
    source "libs/libcpio/Kconfig"
    source "libs/libelf/Kconfig"
    source "libs/libmuslc/Kconfig"
    source "libs/libplatsupport/Kconfig"
    source "libs/libsel4/Kconfig"
    source "libs/libsel4bench/Kconfig"
    source "libs/libsel4debug/Kconfig"
    source "libs/libsel4muslccamkes/Kconfig"
    source "libs/libsel4muslcsys/Kconfig"
    source "libs/libsel4platsupport/Kconfig"
    source "libs/libsel4simple-default/Kconfig"
    source "libs/libsel4simple/Kconfig"
    source "libs/libsel4sync/Kconfig"
    source "libs/libsel4utils/Kconfig"
    source "libs/libsel4vka/Kconfig"
    source "libs/libsel4vspace/Kconfig"
    source "libs/libutils/Kconfig"
endmenu

menu "Applications"
    source "apps/capdl-loader-experimental/Kconfig"
    source "apps/ipcbench/Kconfig"
endmenu

source "tools/camkes/Kconfig"
source "$COMMON_PATH/Kconfig"
```

## apps/ipcbench/Kconfig
```kconfig
config APP_IPCBENCH
    bool "ipcbench CAmkES application"
    default n
    help
        An application to benchmark IPC in seL4.
```
